## linux/drivers/media/platform/espressif/Kconfig
```kconfig
# SPDX-License-Identifier: GPL-2.0-only

config VIDEO_ESP32S31_CAMERA
	tristate "ESP32-S31 parallel camera capture"
	depends on SOC_ESP32S31 && VIDEO_DEV && OF && DMA_ENGINE
	select MEDIA_CONTROLLER
	select VIDEO_V4L2_SUBDEV_API
	select V4L2_FWNODE
	select VIDEOBUF2_DMA_SG
	help
	  Capture eight-bit DVP UYVY video through LCD_CAM and AXI DMA.
	  Frame buffers are allocated as scatter-gather PSRAM pages.

config VIDEO_ESP_MOSAICO_CAMERA_MODULE
	tristate "ESP-Mosaico removable left camera module"
	depends on I2C && OF
	select CRC16
	help
	  Poll the left-slot EEPROM and verify its module descriptor before
	  creating the camera sensor. Remove the sensor when disconnected.
```

## linux/drivers/net/wireless/espressif/Kconfig
```kconfig
# SPDX-License-Identifier: GPL-2.0-only
config ESP32S31_HOSTED
	bool "ESP-Hosted for the ESP32-S31 (shared memory)"
	depends on SOC_ESP32S31 && CFG80211=y && BT=y
	help
	  The ESP-Hosted host driver for the ESP-Hosted firmware on hart 0:
	  Wi-Fi (cfg80211 full-MAC) and Bluetooth HCI.  The frames go
	  through rings in internal SRAM.  Buildroot copies the upstream driver into
	  esp_hosted/ (br2-external/linux).  With MTD, the flash window of
	  the firmware is the MTD device esp32s31-flash, with the partitions
	  of the "flash" child node.
```

## linux/sound/soc/espressif/Kconfig
```kconfig
# SPDX-License-Identifier: GPL-2.0-only
config SND_SOC_ESP32S31_I2S
	tristate "ESP32-S31 standard I2S controller"
	depends on SOC_ESP32S31 || COMPILE_TEST
	depends on OF && COMMON_CLK && HAS_DMA
	select SND_SOC_GENERIC_DMAENGINE_PCM
	help
	  Standard stereo I2S with cyclic AHB DMA, a fractional crystal
	  clock and small coherent PCM buffers. Capture and playback are
	  supported separately; simultaneous streams are not supported.
```
