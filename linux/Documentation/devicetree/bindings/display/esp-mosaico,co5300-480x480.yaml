## linux/Documentation/devicetree/bindings/power/reset/esp,esp32s31-reboot-mode.yaml
```yaml
# SPDX-License-Identifier: (GPL-2.0-only OR BSD-2-Clause)
%YAML 1.2
---
$id: http://devicetree.org/schemas/power/reset/esp,esp32s31-reboot-mode.yaml#
$schema: http://devicetree.org/meta-schemas/core.yaml#

title: Espressif ESP32-S31 ROM download reboot mode

maintainers:
  - whatshu <shussm@qq.com>

description: |
  The LP_SYSTEM control register has a FORCE_DOWNLOAD_BOOT bit which selects
  ROM download mode at the next system reset. The reset itself is provided
  by SBI; this device only selects the boot path.

properties:
  compatible:
    const: esp,esp32s31-reboot-mode
  reg:
    maxItems: 1

required:
  - compatible
  - reg

additionalProperties: false
```

## linux/Documentation/devicetree/bindings/rng/esp,esp32s31-trng.yaml
```yaml
# SPDX-License-Identifier: (GPL-2.0-only OR BSD-2-Clause)
%YAML 1.2
---
$id: http://devicetree.org/schemas/rng/esp,esp32s31-trng.yaml#
$schema: http://devicetree.org/meta-schemas/core.yaml#

title: Espressif ESP32-S31 true random number generator

maintainers:
  - Marco Müller <hello@annoyedmilk.ch>

description: >
  The ESP32-S31 samples a noise source and mixes it with a CRC. Thus,
  different from earlier Espressif chips, it does not need the RF subsystem
  or the SAR ADC. Its clock and reset are one register in the LP peripheral
  clock controller, not a clock provider.

properties:
  compatible:
    const: esp,esp32s31-trng

  reg:
    items:
      - description: generator registers
      - description: clock and reset control

  reg-names:
    items:
      - const: trng
      - const: clkrst

required:
  - compatible
  - reg
  - reg-names

additionalProperties: false

examples:
  - |
    rng@20814000 {
        compatible = "esp,esp32s31-trng";
        reg = <0x20814000 0x100>, <0x2071003c 0x4>;
        reg-names = "trng", "clkrst";
    };
```

## linux/Documentation/devicetree/bindings/rng/espressif,esp32s31-trng.yaml
```yaml
# SPDX-License-Identifier: (GPL-2.0-only OR BSD-2-Clause)
%YAML 1.2
---
$id: http://devicetree.org/schemas/rng/espressif,esp32s31-trng.yaml#
$schema: http://devicetree.org/meta-schemas/core.yaml#

title: Espressif ESP32-S31 true random number generator

maintainers:
  - Marco Müller <hello@annoyedmilk.ch>

description: >
  The ESP32-S31 samples a noise source and mixes it through a CRC, so unlike
  the generator on earlier Espressif parts it needs neither the RF subsystem
  nor the SAR ADC to be running. Its clock and reset are one register in the
  LP peripheral clock controller rather than a clock provider.

properties:
  compatible:
    const: espressif,esp32s31-trng

  reg:
    items:
      - description: generator registers
      - description: clock and reset control

  reg-names:
    items:
      - const: trng
      - const: clkrst

required:
  - compatible
  - reg
  - reg-names

additionalProperties: false

examples:
  - |
    rng@20814000 {
        compatible = "espressif,esp32s31-trng";
        reg = <0x20814000 0x100>, <0x2071003c 0x4>;
        reg-names = "trng", "clkrst";
    };
```

## linux/Documentation/devicetree/bindings/sound/esp,esp32s31-i2s.yaml
```yaml
# SPDX-License-Identifier: (GPL-2.0-only OR BSD-2-Clause)
%YAML 1.2
---
$id: http://devicetree.org/schemas/sound/esp,esp32s31-i2s.yaml#
$schema: http://devicetree.org/meta-schemas/core.yaml#

title: Espressif ESP32-S31 standard I2S controller

maintainers:
  - whatshu <shussm@qq.com>

description: |
  Standard Philips I2S with two 16-bit slots. The controller supplies
  MCLK, BCLK and WS. Playback and capture share clock pads and run
  separately, using the default and capture pin states respectively.

allOf:
  - $ref: dai-common.yaml#

properties:
  compatible:
    const: esp,esp32s31-i2s
  reg:
    maxItems: 1
  clocks:
    items:
      - description: APB register clock
      - description: Fractional master clock
  clock-names:
    items:
      - const: apb
      - const: mclk
  resets:
    maxItems: 1
  dmas:
    items:
      - description: Transmit channel
      - description: Receive channel
  dma-names:
    items:
      - const: tx
      - const: rx
  pinctrl-names:
    items:
      - const: default
      - const: capture
  pinctrl-0: true
  pinctrl-1: true
  "#sound-dai-cells":
    const: 0

required:
  - compatible
  - reg
  - clocks
  - clock-names
  - resets
  - dmas
  - dma-names
  - pinctrl-names
  - pinctrl-0
  - pinctrl-1
  - "#sound-dai-cells"

unevaluatedProperties: false
```

## linux/Documentation/devicetree/bindings/spi/esp,esp32s31-spi.yaml
```yaml
# SPDX-License-Identifier: (GPL-2.0-only OR BSD-2-Clause)
%YAML 1.2
---
$id: http://devicetree.org/schemas/spi/esp,esp32s31-spi.yaml#
$schema: http://devicetree.org/meta-schemas/core.yaml#

title: Espressif ESP32-S31 GPSPI controller

maintainers:
  - whatshu <shussm@qq.com>

description:
  GPSPI master with a 64-byte FIFO. The driver uses PIO, native or GPIO chip
  selects, and single-bit or quad-bit reads and writes in mode 0.

allOf:
  - $ref: spi-controller.yaml#

properties:
  compatible:
    const: esp,esp32s31-spi

  reg:
    maxItems: 1

  clocks:
    items:
      - description: APB register clock
      - description: Master source clock

  clock-names:
    items:
      - const: apb
      - const: core

  resets:
    maxItems: 1

required:
  - compatible
  - reg
  - clocks
  - clock-names
  - resets

unevaluatedProperties: false
```
