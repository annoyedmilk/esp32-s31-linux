## linux/Documentation/devicetree/bindings/net/esp,esp32s31-dwmac.yaml
```yaml
# SPDX-License-Identifier: (GPL-2.0-only OR BSD-2-Clause)
%YAML 1.2
---
$id: http://devicetree.org/schemas/net/esp,esp32s31-dwmac.yaml#
$schema: http://devicetree.org/meta-schemas/core.yaml#

title: Espressif ESP32-S31 DWMAC glue layer

maintainers:
  - Roan Brand <brandroan@gmail.com>

description:
  The DesignWare GMAC 3.70a of the ESP32-S31, with RGMII. The interface mode
  and the RGMII clock paths are in the CNNT_SYS block, which also makes the
  TX clock and has the reset of the GMAC.

select:
  properties:
    compatible:
      contains:
        const: esp,esp32s31-dwmac
  required:
    - compatible

properties:
  compatible:
    items:
      - const: esp,esp32s31-dwmac
      - const: snps,dwmac-3.70a

  reg:
    maxItems: 1

  clocks:
    items:
      - description: Bus clock, which also makes the MDC clock
      - description: RGMII TX clock, 125, 25 or 2.5 MHz for the link speed

  clock-names:
    items:
      - const: stmmaceth
      - const: ref

  resets:
    maxItems: 1

  reset-names:
    const: stmmaceth

  interrupts:
    maxItems: 1

  interrupt-names:
    const: macirq

  esp,cnnt-sys:
    $ref: /schemas/types.yaml#/definitions/phandle
    description: The CNNT_SYS block, with the interface mode registers.

  phy-mode:
    enum:
      - rgmii
      - rgmii-id
      - rgmii-rxid
      - rgmii-txid

required:
  - compatible
  - reg
  - clocks
  - clock-names
  - resets
  - reset-names
  - interrupts
  - interrupt-names
  - esp,cnnt-sys

allOf:
  - $ref: snps,dwmac.yaml#

unevaluatedProperties: false

examples:
  - |
    #include <dt-bindings/clock/esp32s31-clk.h>
    #include <dt-bindings/interrupt-controller/irq.h>

    ethernet@20350000 {
      compatible = "esp,esp32s31-dwmac", "snps,dwmac-3.70a";
      reg = <0x20350000 0x4000>;
      interrupt-parent = <&clic>;
      interrupts = <36 98 IRQ_TYPE_LEVEL_HIGH>;
      interrupt-names = "macirq";
      clocks = <&hp_clkrst ESP32S31_CLK_EMAC_SYS>,
               <&cnnt_sys ESP32S31_CNNT_CLK_EMAC_REF>;
      clock-names = "stmmaceth", "ref";
      resets = <&cnnt_sys ESP32S31_CNNT_RST_EMAC>;
      reset-names = "stmmaceth";
      esp,cnnt-sys = <&cnnt_sys>;
      phy-mode = "rgmii-id";
      snps,pbl = <16>;
      snps,no-pbl-x8;
      snps,force_thresh_dma_mode;
    };
```

## linux/Documentation/devicetree/bindings/net/wireless/esp,esp32s31-hosted-shm.yaml
```yaml
# SPDX-License-Identifier: (GPL-2.0-only OR BSD-2-Clause)
%YAML 1.2
---
$id: http://devicetree.org/schemas/net/wireless/esp,esp32s31-hosted-shm.yaml#
$schema: http://devicetree.org/meta-schemas/core.yaml#

title: Espressif ESP32-S31 ESP-Hosted shared-memory transport

maintainers:
  - Marco Müller <hello@annoyedmilk.ch>

description: >
  The ESP-Hosted firmware on the hart that does not run Linux controls the
  WLAN modem of the ESP32-S31. Linux is the ESP-Hosted host. The two sides
  send ESP-Hosted frames through two byte rings in internal SRAM. One
  cross-core interrupt register signals each direction. Linux sets the
  first. The firmware sets the second and Linux clears it. The firmware
  also maps a window of the SPI flash for Linux to read, and programs and
  erases it for Linux, which cannot drive the flash itself.

properties:
  compatible:
    const: esp,esp32s31-hosted-shm

  reg:
    items:
      - description: shared ring region in internal SRAM
      - description: cross-core doorbell register pair

  reg-names:
    items:
      - const: shm
      - const: doorbell

  interrupts:
    maxItems: 1
    description: doorbell that the firmware sets when it adds frames

  flash:
    type: object
    description: >
      The flash window of the firmware, as an MTD device. Its partitions
      node describes the layout of the window.
    properties:
      partitions:
        type: object
        $ref: /schemas/mtd/partitions/partitions.yaml
    additionalProperties: false

required:
  - compatible
  - reg
  - reg-names
  - interrupts

additionalProperties: false

examples:
  - |
    wifi@2f050000 {
        compatible = "esp,esp32s31-hosted-shm";
        reg = <0x2f050000 0xd000>, <0x20586014 0x8>;
        reg-names = "shm", "doorbell";
        interrupt-parent = <&clic>;
        interrupts = <35 67 4>;
    };
```

## linux/Documentation/devicetree/bindings/net/wireless/esp,esp32s31-wifi.yaml
```yaml
# SPDX-License-Identifier: (GPL-2.0-only OR BSD-2-Clause)
%YAML 1.2
---
$id: http://devicetree.org/schemas/net/wireless/esp,esp32s31-wifi.yaml#
$schema: http://devicetree.org/meta-schemas/core.yaml#

title: Espressif ESP32-S31 WLAN modem

maintainers:
  - Marco Müller <hello@annoyedmilk.ch>

description: >
  ESP-IDF firmware on the hart that does not run Linux controls the WLAN
  modem of the ESP32-S31. The firmware runs 802.11 and its supplicant. It
  sends 802.3 frames, scan results and the association state through rings
  of fixed-size slots in internal SRAM. At the start of that region, the
  firmware writes its ring layout, protocol version, station MAC address and
  association. One cross-core interrupt register signals each direction.
  Linux sets the first. The firmware sets the second and Linux clears it.

allOf:
  - $ref: /schemas/net/network-class.yaml#

properties:
  compatible:
    const: esp,esp32s31-wifi

  reg:
    items:
      - description: shared ring region in internal SRAM
      - description: cross-core doorbell register pair

  reg-names:
    items:
      - const: ipc
      - const: doorbell

  interrupts:
    maxItems: 1
    description: doorbell that the firmware sets when it adds frames

required:
  - compatible
  - reg
  - reg-names
  - interrupts

unevaluatedProperties: false

examples:
  - |
    wifi@2f050000 {
        compatible = "esp,esp32s31-wifi";
        reg = <0x2f050000 0x10000>, <0x20586014 0x8>;
        reg-names = "ipc", "doorbell";
        interrupt-parent = <&clic>;
        interrupts = <35 67 4>;
    };
```

## linux/Documentation/devicetree/bindings/net/wireless/espressif,esp32s31-wifi.yaml
```yaml
# SPDX-License-Identifier: (GPL-2.0-only OR BSD-2-Clause)
%YAML 1.2
---
$id: http://devicetree.org/schemas/net/wireless/espressif,esp32s31-wifi.yaml#
$schema: http://devicetree.org/meta-schemas/core.yaml#

title: Espressif ESP32-S31 WLAN modem

maintainers:
  - Marco Müller <hello@annoyedmilk.ch>

description: >
  The WLAN modem of the ESP32-S31 is owned by ESP-IDF firmware resident on the
  hart that does not run Linux, which keeps the 802.11 side to itself and
  exchanges 802.3 frames through fixed-size slot rings in internal SRAM. The
  firmware publishes its ring layout, protocol version and station MAC address
  at the start of that region. Each direction is signalled by one of the
  cross-core interrupt registers, the first raised by the firmware and
  acknowledged by Linux, the second raised by Linux.

allOf:
  - $ref: /schemas/net/network-class.yaml#

properties:
  compatible:
    const: espressif,esp32s31-wifi

  reg:
    items:
      - description: shared ring region in internal SRAM
      - description: cross-core doorbell register pair

  reg-names:
    items:
      - const: ipc
      - const: doorbell

  interrupts:
    maxItems: 1
    description: doorbell raised by the firmware when frames are queued

required:
  - compatible
  - reg
  - reg-names
  - interrupts

unevaluatedProperties: false

examples:
  - |
    wifi@2f050000 {
        compatible = "espressif,esp32s31-wifi";
        reg = <0x2f050000 0x10000>, <0x20586010 0x8>;
        reg-names = "ipc", "doorbell";
        interrupt-parent = <&clic>;
        interrupts = <35 65 4>;
    };
```

## linux/Documentation/devicetree/bindings/nvmem/esp,esp32s31-efuse.yaml
```yaml
# SPDX-License-Identifier: (GPL-2.0-only OR BSD-2-Clause)
%YAML 1.2
---
$id: http://devicetree.org/schemas/nvmem/esp,esp32s31-efuse.yaml#
$schema: http://devicetree.org/meta-schemas/core.yaml#

title: Espressif ESP32-S31 eFuse

maintainers:
  - Marco Mueller <hello@annoyedmilk.ch>

description: |
  The eFuse controller shows the eFuse blocks in its read registers. The
  offset of a cell is the register offset. The factory MAC address is at
  0x50, 6 bytes, in the reverse order.

  A cell with the name "mac-address" takes one argument. It selects the
  address as ESP-IDF makes it from the factory address, with two universal
  addresses for each chip: 0 Wi-Fi station, 1 Wi-Fi access point,
  2 Bluetooth, 3 Ethernet. 1 and 3 are the locally administered forms of
  0 and 2.

allOf:
  - $ref: nvmem.yaml#

properties:
  compatible:
    const: esp,esp32s31-efuse

  reg:
    maxItems: 1

required:
  - compatible
  - reg

unevaluatedProperties: false

examples:
  - |
    efuse@20715000 {
        compatible = "esp,esp32s31-efuse";
        reg = <0x20715000 0x168>;
        read-only;

        nvmem-layout {
            compatible = "fixed-layout";
            #address-cells = <1>;
            #size-cells = <1>;

            mac_address: mac-address@50 {
                reg = <0x50 0x6>;
                #nvmem-cell-cells = <1>;
            };
        };
    };
```

## linux/Documentation/devicetree/bindings/phy/esp,esp32s31-usb-phy.yaml
```yaml
# SPDX-License-Identifier: (GPL-2.0-only OR BSD-2-Clause)
%YAML 1.2
---
$id: http://devicetree.org/schemas/phy/esp,esp32s31-usb-phy.yaml#
$schema: http://devicetree.org/meta-schemas/core.yaml#

title: Espressif ESP32-S31 USB 2.0 UTMI PHY

maintainers:
  - Marco Mueller <hello@annoyedmilk.ch>

description:
  The ESP32-S31 has a high-speed UTMI PHY for its Synopsys DWC2 controller.
  Its clock, reset, host pull-down and low-speed mode controls are in
  different SoC system register blocks.

properties:
  compatible:
    const: esp,esp32s31-usb-phy

  reg:
    minItems: 5
    maxItems: 5

  reg-names:
    items:
      - const: clkrst
      - const: cnnt
      - const: usb-ctrl
      - const: otghs-ctrl
      - const: utmi-fc06

  "#phy-cells":
    const: 0

required:
  - compatible
  - reg
  - reg-names
  - "#phy-cells"

additionalProperties: false

examples:
  - |
    phy@205870ac {
        compatible = "esp,esp32s31-usb-phy";
        reg = <0x205870ac 0x4>, <0x20359030 0x4>,
              <0x20589024 0x4>, <0x205890b0 0x4>,
              <0x20380018 0x4>;
        reg-names = "clkrst", "cnnt", "usb-ctrl", "otghs-ctrl",
                    "utmi-fc06";
        #phy-cells = <0>;
    };
...
```

## linux/Documentation/devicetree/bindings/phy/espressif,esp32s31-usb-phy.yaml
```yaml
# SPDX-License-Identifier: (GPL-2.0-only OR BSD-2-Clause)
%YAML 1.2
---
$id: http://devicetree.org/schemas/phy/espressif,esp32s31-usb-phy.yaml#
$schema: http://devicetree.org/meta-schemas/core.yaml#

title: Espressif ESP32-S31 USB 2.0 UTMI PHY

maintainers:
  - Marco Mueller <hello@annoyedmilk.ch>

description:
  The ESP32-S31 integrates a high-speed UTMI PHY connected to its Synopsys
  DWC2 controller.  Its clock, reset, host pull-down, and low-speed mode
  controls reside in several SoC system register blocks.

properties:
  compatible:
    const: espressif,esp32s31-usb-phy

  reg:
    minItems: 5
    maxItems: 5

  reg-names:
    items:
      - const: clkrst
      - const: cnnt
      - const: usb-ctrl
      - const: otghs-ctrl
      - const: utmi-fc06

  "#phy-cells":
    const: 0

required:
  - compatible
  - reg
  - reg-names
  - "#phy-cells"

additionalProperties: false

examples:
  - |
    phy@205870ac {
        compatible = "espressif,esp32s31-usb-phy";
        reg = <0x205870ac 0x4>, <0x20359030 0x4>,
              <0x20589024 0x4>, <0x205890b0 0x4>,
              <0x20380018 0x4>;
        reg-names = "clkrst", "cnnt", "usb-ctrl", "otghs-ctrl",
                    "utmi-fc06";
        #phy-cells = <0>;
    };
...
```

## linux/Documentation/devicetree/bindings/pinctrl/esp,esp32s31-pinctrl.yaml
```yaml
# SPDX-License-Identifier: (GPL-2.0-only OR BSD-2-Clause)
%YAML 1.2
---
$id: http://devicetree.org/schemas/pinctrl/esp,esp32s31-pinctrl.yaml#
$schema: http://devicetree.org/meta-schemas/core.yaml#

title: Espressif ESP32-S31 pin controller and GPIO controller

maintainers:
  - Marco Mueller <hello@annoyedmilk.ch>

description:
  Two blocks control each of the 62 pads. The IO MUX selects the function of
  the pad, a peripheral directly or the GPIO matrix, and sets the pull, the
  drive strength and the input buffer. The GPIO matrix connects a peripheral
  signal or the GPIO registers to the pad. The GPIO registers are in the
  block of the matrix, so one node is the pin controller and the GPIO
  controller. GPIO29 and GPIO41 have no package pin.

properties:
  compatible:
    const: esp,esp32s31-pinctrl

  reg:
    items:
      - description: IO MUX registers
      - description: GPIO and GPIO matrix registers
      - description: CNNT_IO_MUX_CTRL, the select bits of the GMAC and SD pads

  reg-names:
    items:
      - const: iomux
      - const: gpio
      - const: cnnt

  gpio-controller: true

  "#gpio-cells":
    const: 2

  gpio-ranges:
    maxItems: 1

  gpio-reserved-ranges:
    description:
      The pins of the flash, of the firmware on the other hart and of the
      loader, which the operating system must not use as GPIOs.

patternProperties:
  '-cfg$':
    type: object
    additionalProperties: false

    description:
      A pin configuration state. It has one or more subnodes, each with pins
      that get the same configuration.

    patternProperties:
      '-pins$':
        type: object
        additionalProperties: false

        allOf:
          - $ref: pincfg-node.yaml#
          - $ref: pinmux-node.yaml#

        properties:
          pinmux:
            description:
              One cell for each signal of a pin, made with the macros in
              dt-bindings/pinctrl/esp32s31-pinctrl.h. A pin with an input
              and an output signal of different numbers has two cells.

          bias-disable: true

          bias-pull-down: true

          bias-pull-up: true

          drive-strength:
            enum: [ 5, 10, 20, 40 ]

          input-enable: true

          input-disable: true

          drive-open-drain: true

          drive-push-pull: true

        required:
          - pinmux

required:
  - compatible
  - reg
  - reg-names
  - gpio-controller
  - "#gpio-cells"
  - gpio-ranges

additionalProperties: false

examples:
  - |
    #include <dt-bindings/pinctrl/esp32s31-pinctrl.h>

    pinctrl: pinctrl@20582000 {
        compatible = "esp,esp32s31-pinctrl";
        reg = <0x20582000 0x1000>, <0x20583000 0x1000>,
              <0x205883f4 0x4>;
        reg-names = "iomux", "gpio", "cnnt";
        gpio-controller;
        #gpio-cells = <2>;
        gpio-ranges = <&pinctrl 0 0 62>;
        gpio-reserved-ranges = <26 9>, <41 1>, <58 2>;

        i2c0_cfg: i2c0-cfg {
            i2c0-pins {
                pinmux = <ESP32S31_MATRIX_INOUT(0, ESP32S31_SIG_I2C0_SDA)>,
                         <ESP32S31_MATRIX_INOUT(1, ESP32S31_SIG_I2C0_SCL)>;
                bias-pull-up;
                drive-open-drain;
            };
        };

        mdio_cfg: mdio-cfg {
            mdio-pins {
                pinmux = <ESP32S31_MATRIX_OUT(5, ESP32S31_SIG_GMII_MDC)>,
                         <ESP32S31_MATRIX_OUT(6, ESP32S31_SIG_GMII_MDO)>,
                         <ESP32S31_MATRIX_IN(6, ESP32S31_SIG_GMII_MDI)>;
                bias-disable;
            };
        };
    };
```
