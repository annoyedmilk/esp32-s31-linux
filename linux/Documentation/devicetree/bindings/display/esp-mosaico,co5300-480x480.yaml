## linux/Documentation/devicetree/bindings/display/esp-mosaico,co5300-480x480.yaml
```yaml
# SPDX-License-Identifier: (GPL-2.0-only OR BSD-2-Clause)
%YAML 1.2
---
$id: http://devicetree.org/schemas/display/esp-mosaico,co5300-480x480.yaml#
$schema: http://devicetree.org/meta-schemas/core.yaml#

title: ESP-Mosaico 480x480 CO5300 QSPI AMOLED panel

maintainers:
  - whatshu <shussm@qq.com>

description:
  The 480x480 RGB565 CO5300 panel fitted to ESP-Mosaico CoreBoard V1.2.
  Commands use a single data line and pixel writes use four data lines.

allOf:
  - $ref: /schemas/spi/spi-peripheral-props.yaml#

properties:
  compatible:
    const: esp-mosaico,co5300-480x480

  reg:
    maxItems: 1

  spi-max-frequency:
    maximum: 40000000

  spi-tx-bus-width:
    items:
      - const: 4

  reset-gpios:
    maxItems: 1
    description: Active-low hardware reset

  vdd-supply:
    description: Shared 3.3 V peripheral power rail

required:
  - compatible
  - reg
  - spi-tx-bus-width
  - reset-gpios
  - vdd-supply

unevaluatedProperties: false
```

## linux/Documentation/devicetree/bindings/dma/esp,esp32s31-ahb-dma.yaml
```yaml
# SPDX-License-Identifier: (GPL-2.0-only OR BSD-2-Clause)
%YAML 1.2
---
$id: http://devicetree.org/schemas/dma/esp,esp32s31-ahb-dma.yaml#
$schema: http://devicetree.org/meta-schemas/core.yaml#

title: Espressif ESP32-S31 AHB peripheral DMA

maintainers:
  - whatshu <shussm@qq.com>

description: |
  Five receive and five transmit channels. The first DMA cell selects
  receive channel 0 to 4 or transmit channel 5 to 9. The second selects
  the peripheral request, with 1 selecting I2S0. Request 9 is reserved.
  Audio uses a cyclic ring of descriptors and coherent PCM buffers.

allOf:
  - $ref: dma-controller.yaml#

properties:
  compatible:
    const: esp,esp32s31-ahb-dma
  reg:
    maxItems: 1
  interrupts:
    minItems: 10
    maxItems: 10
    description: Receive channels 0 to 4, then transmit channels 0 to 4.
  clocks:
    maxItems: 1
  resets:
    maxItems: 1
  "#dma-cells":
    const: 2

required:
  - compatible
  - reg
  - interrupts
  - clocks
  - resets
  - "#dma-cells"

additionalProperties: false
```

## linux/Documentation/devicetree/bindings/dma/esp,esp32s31-axi-dma.yaml
```yaml
# SPDX-License-Identifier: (GPL-2.0-only OR BSD-2-Clause)
%YAML 1.2
---
$id: http://devicetree.org/schemas/dma/esp,esp32s31-axi-dma.yaml#
$schema: http://devicetree.org/meta-schemas/core.yaml#

title: Espressif ESP32-S31 AXI peripheral DMA

maintainers:
  - whatshu <shussm@qq.com>

description: |
  Three peripheral receive channels. The first DMA cell selects channel 0 to
  2; the second selects the peripheral request (0 CAM, 1 GPSPI2, 2 GPSPI3,
  3 I3C, 4 UHCI0, 5 UHCI1). This driver supports device-to-memory transfers.

allOf:
  - $ref: dma-controller.yaml#

properties:
  compatible:
    const: esp,esp32s31-axi-dma
  reg:
    maxItems: 1
  interrupts:
    minItems: 3
    maxItems: 3
  clocks:
    maxItems: 1
  resets:
    maxItems: 1
  "#dma-cells":
    const: 2

required:
  - compatible
  - reg
  - interrupts
  - clocks
  - resets
  - "#dma-cells"

additionalProperties: false
```

## linux/Documentation/devicetree/bindings/gpio/esp,esp32s31-gpio.yaml
```yaml
# SPDX-License-Identifier: (GPL-2.0-only OR BSD-2-Clause)
%YAML 1.2
---
$id: http://devicetree.org/schemas/gpio/esp,esp32s31-gpio.yaml#
$schema: http://devicetree.org/meta-schemas/core.yaml#

title: Espressif ESP32-S31 GPIO controller

maintainers:
  - Marco Mueller <hello@annoyedmilk.ch>

description:
  Two blocks control each pad. IO MUX selects the peripheral that uses the
  pad. The GPIO matrix connects a signal to it. Thus a GPIO needs the two
  register windows. Of the 62 pads, GPIO29 and GPIO41 have no package pin.

properties:
  compatible:
    const: esp,esp32s31-gpio

  reg:
    items:
      - description: GPIO matrix registers
      - description: IO MUX registers

  reg-names:
    items:
      - const: gpio
      - const: iomux

  gpio-controller: true

  "#gpio-cells":
    const: 2

required:
  - compatible
  - reg
  - reg-names
  - gpio-controller
  - "#gpio-cells"

additionalProperties: false

examples:
  - |
    gpio@20583000 {
        compatible = "esp,esp32s31-gpio";
        reg = <0x20583000 0x1000>, <0x20582000 0x1000>;
        reg-names = "gpio", "iomux";
        gpio-controller;
        #gpio-cells = <2>;
    };
```

## linux/Documentation/devicetree/bindings/i2c/esp,esp32s31-i2c.yaml
```yaml
# SPDX-License-Identifier: (GPL-2.0-only OR BSD-2-Clause)
%YAML 1.2
---
$id: http://devicetree.org/schemas/i2c/esp,esp32s31-i2c.yaml#
$schema: http://devicetree.org/meta-schemas/core.yaml#

title: Espressif ESP32-S31 I2C controller

maintainers:
  - Marco Mueller <hello@annoyedmilk.ch>

description:
  The two I2C controllers of the ESP32-S31 in master mode, with a list of 8
  commands and a 32-byte FIFO for each direction. The pins come through the
  GPIO matrix.

allOf:
  - $ref: /schemas/i2c/i2c-controller.yaml#

properties:
  compatible:
    const: esp,esp32s31-i2c

  reg:
    maxItems: 1

  interrupts:
    maxItems: 1

  clocks:
    items:
      - description: APB bus clock of the registers
      - description: Core clock, the source of the SCL timing

  clock-names:
    items:
      - const: apb
      - const: core

  resets:
    maxItems: 1

  clock-frequency:
    maximum: 1000000

required:
  - compatible
  - reg
  - interrupts
  - clocks
  - clock-names
  - resets

unevaluatedProperties: false

examples:
  - |
    #include <dt-bindings/clock/esp32s31-clk.h>
    #include <dt-bindings/interrupt-controller/irq.h>

    i2c@20385000 {
        compatible = "esp,esp32s31-i2c";
        reg = <0x20385000 0x1000>;
        interrupt-parent = <&clic>;
        interrupts = <37 23 IRQ_TYPE_LEVEL_HIGH>;
        clocks = <&hp_clkrst ESP32S31_CLK_I2C0_APB>,
                 <&hp_clkrst ESP32S31_CLK_I2C0>;
        clock-names = "apb", "core";
        resets = <&hp_clkrst ESP32S31_RST_I2C0>;
        clock-frequency = <400000>;
        #address-cells = <1>;
        #size-cells = <0>;
    };
```

## linux/Documentation/devicetree/bindings/input/touchscreen/hynitron,cst9220.yaml
```yaml
# SPDX-License-Identifier: (GPL-2.0-only OR BSD-2-Clause)
%YAML 1.2
---
$id: http://devicetree.org/schemas/input/touchscreen/hynitron,cst9220.yaml#
$schema: http://devicetree.org/meta-schemas/core.yaml#

title: Hynitron CST9220 touchscreen controller

maintainers:
  - whatshu <shussm@qq.com>

description:
  I2C touch controller with up to five simultaneous contacts. Reports are
  polled; the driver does not require an interrupt line.

allOf:
  - $ref: touchscreen.yaml#

properties:
  compatible:
    const: hynitron,cst9220

  reg:
    maxItems: 1

  vdd-supply:
    description: Peripheral power supply

required:
  - compatible
  - reg
  - vdd-supply
  - touchscreen-size-x
  - touchscreen-size-y

unevaluatedProperties: false

examples:
  - |
    i2c {
        #address-cells = <1>;
        #size-cells = <0>;

        touchscreen@5a {
            compatible = "hynitron,cst9220";
            reg = <0x5a>;
            vdd-supply = <&vcc_3v3>;
            touchscreen-size-x = <480>;
            touchscreen-size-y = <480>;
        };
    };
```

## linux/Documentation/devicetree/bindings/interrupt-controller/esp,esp32s31-clic.yaml
```yaml
# SPDX-License-Identifier: (GPL-2.0-only OR BSD-2-Clause)
%YAML 1.2
---
$id: http://devicetree.org/schemas/interrupt-controller/esp,esp32s31-clic.yaml#
$schema: http://devicetree.org/meta-schemas/core.yaml#

title: Espressif ESP32-S31 Core-Local Interrupt Controller

maintainers:
  - Marco Müller <hello@annoyedmilk.ch>

description: >
  Each ESP32-S31 core has a CLIC with 48 inputs: 16 architectural local
  causes, then 32 inputs from the Interrupt Matrix of that core. The matrix
  connects SoC interrupt sources to these inputs. All cores use the same
  physical address for the register window, and each core sees its own
  registers. The supervisor window shows an input only after the
  machine-mode firmware gives it to S-mode. Thus this binding describes only
  the supervisor view.

  A peripheral interrupt is only a SoC source number until the matrix
  connects it. Thus an interrupt specifier has three cells: the CLIC input,
  the SoC interrupt source for that input, and the trigger type.

properties:
  compatible:
    const: esp,esp32s31-clic

  reg:
    items:
      - description: supervisor CLIC register window
      - description: Interrupt Matrix routing blocks for both cores

  reg-names:
    items:
      - const: clic
      - const: intmatrix

  interrupt-controller: true

  "#interrupt-cells":
    const: 3

required:
  - compatible
  - reg
  - reg-names
  - interrupt-controller
  - "#interrupt-cells"

additionalProperties: false

examples:
  - |
    interrupt-controller@10a00000 {
        compatible = "esp,esp32s31-clic";
        reg = <0x10a00000 0x20000>, <0x20585000 0x1000>;
        reg-names = "clic", "intmatrix";
        interrupt-controller;
        #interrupt-cells = <3>;
    };
```

## linux/Documentation/devicetree/bindings/interrupt-controller/espressif,esp32s31-clic.yaml
```yaml
# SPDX-License-Identifier: (GPL-2.0-only OR BSD-2-Clause)
%YAML 1.2
---
$id: http://devicetree.org/schemas/interrupt-controller/espressif,esp32s31-clic.yaml#
$schema: http://devicetree.org/meta-schemas/core.yaml#

title: Espressif ESP32-S31 Core-Local Interrupt Controller

maintainers:
  - Marco Müller <hello@annoyedmilk.ch>

description: >
  Each ESP32-S31 core has a CLIC with 48 inputs, 16 architectural local causes
  followed by 32 inputs fed from a per-core Interrupt Matrix that routes SoC
  interrupt sources onto them. The register window is per-core virtualised at
  a single physical address, and machine-mode firmware must delegate an input
  before the supervisor window shows it at all, so this binding describes the
  supervisor view only.

  Because a peripheral interrupt exists as a SoC source number until the
  matrix routes it, an interrupt specifier carries three cells, the CLIC input
  to deliver on, the SoC interrupt source to route there, and the trigger type.

properties:
  compatible:
    const: espressif,esp32s31-clic

  reg:
    items:
      - description: supervisor CLIC register window
      - description: Interrupt Matrix routing blocks for both cores

  reg-names:
    items:
      - const: clic
      - const: intmatrix

  interrupt-controller: true

  "#interrupt-cells":
    const: 3

required:
  - compatible
  - reg
  - reg-names
  - interrupt-controller
  - "#interrupt-cells"

additionalProperties: false

examples:
  - |
    interrupt-controller@10a00000 {
        compatible = "espressif,esp32s31-clic";
        reg = <0x10a00000 0x20000>, <0x20585000 0x1000>;
        reg-names = "clic", "intmatrix";
        interrupt-controller;
        #interrupt-cells = <3>;
    };
```

## linux/Documentation/devicetree/bindings/leds/esp,esp32s31-rmt-ws2812.yaml
```yaml
# SPDX-License-Identifier: (GPL-2.0-only OR BSD-2-Clause)
%YAML 1.2
---
$id: http://devicetree.org/schemas/leds/esp,esp32s31-rmt-ws2812.yaml#
$schema: http://devicetree.org/meta-schemas/core.yaml#

title: Espressif ESP32-S31 WS2812 RGB LED on the RMT

maintainers:
  - Marco Müller <hello@annoyedmilk.ch>

description: >
  One WS2812 RGB LED on RMT channel 0 of the ESP32-S31. The pin control
  state routes the channel 0 output to the LED pin.

properties:
  compatible:
    const: esp,esp32s31-rmt-ws2812

  reg:
    items:
      - description: RMT registers
      - description: HP_SYSTEM_RMT_MEM_LP_CTRL, the power control of the RMT RAM

  clocks:
    items:
      - description: RMT bus clock
      - description: RMT function clock

  clock-names:
    items:
      - const: sys
      - const: core

  resets:
    maxItems: 1

  led:
    type: object
    $ref: leds-class-multicolor.yaml#
    unevaluatedProperties: false

required:
  - compatible
  - reg
  - clocks
  - clock-names
  - resets
  - led

additionalProperties: false

examples:
  - |
    #include <dt-bindings/clock/esp32s31-clk.h>
    #include <dt-bindings/leds/common.h>

    led-controller@20355000 {
        compatible = "esp,esp32s31-rmt-ws2812";
        reg = <0x20355000 0x1000>, <0x20586204 0x4>;
        clocks = <&hp_clkrst ESP32S31_CLK_RMT_SYS>,
                 <&hp_clkrst ESP32S31_CLK_RMT>;
        clock-names = "sys", "core";
        resets = <&hp_clkrst ESP32S31_RST_RMT>;

        led {
            color = <LED_COLOR_ID_RGB>;
            function = LED_FUNCTION_STATUS;
        };
    };
```

## linux/Documentation/devicetree/bindings/media/esp,esp32s31-camera.yaml
```yaml
# SPDX-License-Identifier: (GPL-2.0-only OR BSD-2-Clause)
%YAML 1.2
---
$id: http://devicetree.org/schemas/media/esp,esp32s31-camera.yaml#
$schema: http://devicetree.org/meta-schemas/core.yaml#

title: Espressif ESP32-S31 parallel camera receiver

maintainers:
  - whatshu <shussm@qq.com>

properties:
  compatible:
    const: esp,esp32s31-camera
  reg:
    maxItems: 1
  clocks:
    minItems: 4
    maxItems: 4
  clock-names:
    items:
      - const: apb
      - const: sys
      - const: core
      - const: cam
  resets:
    minItems: 2
    maxItems: 2
  dmas:
    maxItems: 1
  dma-names:
    const: rx
  port:
    $ref: /schemas/graph.yaml#/$defs/port-base
    unevaluatedProperties: false
    properties:
      endpoint:
        $ref: video-interfaces.yaml#
        unevaluatedProperties: false
        properties:
          bus-width:
            const: 8
        required:
          - bus-width

required:
  - compatible
  - reg
  - clocks
  - clock-names
  - resets
  - dmas
  - dma-names
  - port

additionalProperties: false
```

## linux/Documentation/devicetree/bindings/media/esp-mosaico,camera-module.yaml
```yaml
# SPDX-License-Identifier: (GPL-2.0-only OR BSD-2-Clause)
%YAML 1.2
---
$id: http://devicetree.org/schemas/media/esp-mosaico,camera-module.yaml#
$schema: http://devicetree.org/meta-schemas/core.yaml#

title: ESP-Mosaico removable CameraBoard descriptor EEPROM

maintainers:
  - whatshu <shussm@qq.com>

description: |
  The left-slot EEPROM at 0x50 contains a CRC-protected ESP module descriptor.
  Presence is polled without writing the EEPROM. The sensor node must be
  disabled so the module driver can instantiate it only while connected.

properties:
  compatible:
    const: esp-mosaico,camera-module
  reg:
    const: 0x50
  sensor:
    $ref: /schemas/types.yaml#/definitions/phandle
    description: Disabled SC101IOT sensor node on the same I2C adapter

required:
  - compatible
  - reg
  - sensor

additionalProperties: false
```

## linux/Documentation/devicetree/bindings/media/smartsens,sc101iot.yaml
```yaml
# SPDX-License-Identifier: (GPL-2.0-only OR BSD-2-Clause)
%YAML 1.2
---
$id: http://devicetree.org/schemas/media/smartsens,sc101iot.yaml#
$schema: http://devicetree.org/meta-schemas/core.yaml#

title: SmartSens SC101IOT parallel camera sensor

maintainers:
  - whatshu <shussm@qq.com>

allOf:
  - $ref: /schemas/media/video-interface-devices.yaml#

properties:
  compatible:
    const: smartsens,sc101iot
  reg:
    maxItems: 1
  clocks:
    maxItems: 1
    description: Board-supplied 20 MHz input clock
  vdd-supply: true
  powerdown-gpios:
    maxItems: 1
  port:
    $ref: /schemas/graph.yaml#/$defs/port-base
    unevaluatedProperties: false
    properties:
      endpoint:
        $ref: video-interfaces.yaml#
        unevaluatedProperties: false
        properties:
          bus-width:
            const: 8

required:
  - compatible
  - reg
  - clocks
  - vdd-supply
  - powerdown-gpios
  - port

unevaluatedProperties: false
```
