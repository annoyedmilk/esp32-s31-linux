## bootloader/components/esp_hosted/Kconfig.projbuild
```kconfig
orsource "../../../external/esp-hosted-linux/esp/esp_driver/network_adapter/main/Kconfig.projbuild"
```

## bootloader/main/Kconfig.projbuild
```kconfig
menu "ESP32-S31 Linux loader"

config S31_LINUX_DISPLAY
    bool "Start the 800x480 RGB panel of the ESP32-S31-Korvo-1"
    default n
    help
        The loader starts the panel and keeps its frame buffer at
        0x50F40000 for Linux.  sdkconfig.defaults.korvo1 sets it.

endmenu
```

## br2-external/Config.in
```kconfig
source "$BR2_EXTERNAL_ESP32S31_PATH/package/bmi270-firmware/Config.in"
source "$BR2_EXTERNAL_ESP32S31_PATH/package/camera-preview/Config.in"
source "$BR2_EXTERNAL_ESP32S31_PATH/package/esp-hosted-linux/Config.in"
source "$BR2_EXTERNAL_ESP32S31_PATH/package/fastfetch/Config.in"
source "$BR2_EXTERNAL_ESP32S31_PATH/package/sc101iot-firmware/Config.in"
source "$BR2_EXTERNAL_ESP32S31_PATH/package/strace-rv32/Config.in"
source "$BR2_EXTERNAL_ESP32S31_PATH/package/openthread/Config.in"
source "$BR2_EXTERNAL_ESP32S31_PATH/package/esp32s31-pinctrl/Config.in"
source "$BR2_EXTERNAL_ESP32S31_PATH/package/thread-relay/Config.in"
source "$BR2_EXTERNAL_ESP32S31_PATH/package/ble-ha/Config.in"
```

## br2-external/package/ble-ha/Config.in
```kconfig
config BR2_PACKAGE_BLE_HA
	bool "ble-ha"
	help
	  Bluetooth LE for Home Assistant: a passive Bluetooth proxy with
	  the ESPHome native API, and Improv Wi-Fi setup over BLE while
	  Wi-Fi has no network.  /etc/default/ble-ha turns them on.
```

## br2-external/package/bmi270-firmware/Config.in
```kconfig
config BR2_PACKAGE_BMI270_FIRMWARE
	bool "Bosch BMI270 initialization data"
	help
	  Install the Bosch BMI270 initialization image used by the
	  kernel IIO driver. The sensor requires this image after reset.
```

## br2-external/package/camera-preview/Config.in
```kconfig
config BR2_PACKAGE_CAMERA_PREVIEW
	bool "camera-preview"
	help
	  Foreground V4L2-to-fbdev preview for ESP-Mosaico CameraBoard.
	  Reconnects after module removal. Requires a 480x480 RGB565
	  framebuffer and a 640x480 UYVY V4L2 capture device at runtime.
```

## br2-external/package/esp-hosted-linux/Config.in
```kconfig
config BR2_PACKAGE_ESP_HOSTED_LINUX
	bool
	help
	  The ESP-Hosted host driver sources.  Select
	  BR2_LINUX_KERNEL_EXT_ESP_HOSTED_LINUX to build them into the
	  kernel.
```

## br2-external/package/esp32s31-pinctrl/Config.in
```kconfig
config BR2_PACKAGE_ESP32S31_PINCTRL
	bool "esp32s31-pinctrl"
	help
	  pinctrl shows and changes the state of the ESP32-S31 pins from
	  the registers, with the command line of the Raspberry Pi tool.
	  It needs /dev/esp32s31-gpiomem of the kernel pin driver
	  (CONFIG_PINCTRL_ESP32S31_GPIOMEM).
```

## br2-external/package/fastfetch/Config.in
```kconfig
config BR2_PACKAGE_FASTFETCH
	bool "fastfetch"
	depends on BR2_TOOLCHAIN_GCC_AT_LEAST_13 # C23
	help
	  Shows information about the system next to a logo.  This
	  build has no desktop, GPU, image logo or scripting support.

	  https://github.com/fastfetch-cli/fastfetch
```

## br2-external/package/mosaico-test/Config.in
```kconfig
config BR2_PACKAGE_MOSAICO_TEST
	bool "mosaico-test"
	depends on BR2_USE_MMU # fork()
	depends on BR2_TOOLCHAIN_HAS_THREADS
	select BR2_PACKAGE_ALSA_LIB
	select BR2_PACKAGE_CAMERA_PREVIEW
	help
	  Manually launched LVGL peripheral test interface for ESP-Mosaico
	  CoreBoard V1.2. Requires the pinned external/lvgl submodule.
	  Uses the framebuffer, touchscreen and Linux peripheral interfaces.
	  No boot service or automatic audio playback is installed.
```

## br2-external/package/openthread/Config.in
```kconfig
config BR2_PACKAGE_OPENTHREAD
	bool "openthread"
	depends on BR2_INSTALL_LIBSTDCPP
	depends on BR2_TOOLCHAIN_HAS_THREADS
	depends on BR2_USE_MMU
	help
	  OpenThread as a Thread host: ot-daemon, which runs the Thread
	  stack on a radio co-processor, and ot-ctl to control it.

	  https://openthread.io

comment "openthread needs a toolchain w/ C++, threads"
	depends on !BR2_INSTALL_LIBSTDCPP || !BR2_TOOLCHAIN_HAS_THREADS
```

## br2-external/package/sc101iot-firmware/Config.in
```kconfig
config BR2_PACKAGE_SC101IOT_FIRMWARE
	bool "SC101IOT sensor initialization data"
	help
	  Install the Espressif SC101IOT VGA UYVY mode data for the
	  Linux camera driver. The camera module supplies a 20 MHz clock.
```

## br2-external/package/strace-rv32/Config.in
```kconfig
config BR2_PACKAGE_STRACE_RV32
	bool "strace (RISC-V 32-bit port)"
	depends on BR2_RISCV_32
	depends on BR2_TOOLCHAIN_HEADERS_AT_LEAST_5_1 # time_types.h
	help
	  strace with a port to RISC-V 32-bit.  The strace package of
	  Buildroot does not support RV32, and upstream strace has no
	  riscv32 directory.  The port uses the riscv64 register code
	  with the generic 32-bit syscall table.

	  https://strace.io
```

## br2-external/package/thread-relay/Config.in
```kconfig
config BR2_PACKAGE_THREAD_RELAY
	bool "thread-relay"
	help
	  thread-relay gives the Spinel stream of the IEEE 802.15.4 RCP
	  (/dev/esp_rcp0) to one TCP client: otbr-agent of the OpenThread
	  Border Router app of Home Assistant, with network_device.
	  thread-start runs it in place of ot-daemon when
	  /etc/default/thread says THREAD_MODE=relay.
```

## linux/Documentation/devicetree/bindings/cache/esp,esp32s31-cache.yaml
```yaml
# SPDX-License-Identifier: (GPL-2.0-only OR BSD-2-Clause)
%YAML 1.2
---
$id: http://devicetree.org/schemas/cache/esp,esp32s31-cache.yaml#
$schema: http://devicetree.org/meta-schemas/core.yaml#

title: Espressif ESP32-S31 cache controller

maintainers:
  - Marco Müller <hello@annoyedmilk.ch>

description:
  The ESP32-S31 cache controller is in front of the external PSRAM aperture.
  Its sync engine does invalidate, writeback and writeback-invalidate
  operations on an address range. The kernel uses them for DMA cache
  maintenance, because the hart has no Zicbom and the SoC has no uncached
  alias of that aperture. The engine registers are global, so the M-mode
  firmware programs them and the kernel asks it for each operation.

properties:
  compatible:
    const: esp,esp32s31-cache

  reg:
    maxItems: 1

  cache-line-size:
    const: 64

  cache-level:
    const: 1

required:
  - compatible
  - reg

additionalProperties: false

examples:
  - |
    cache-controller@2c000000 {
        compatible = "esp,esp32s31-cache";
        reg = <0x2c000000 0x1000>;
        cache-line-size = <64>;
        cache-level = <1>;
    };
```

## linux/Documentation/devicetree/bindings/cache/espressif,esp32s31-cache.yaml
```yaml
# SPDX-License-Identifier: (GPL-2.0-only OR BSD-2-Clause)
%YAML 1.2
---
$id: http://devicetree.org/schemas/cache/espressif,esp32s31-cache.yaml#
$schema: http://devicetree.org/meta-schemas/core.yaml#

title: Espressif ESP32-S31 cache controller

maintainers:
  - Marco Müller <hello@annoyedmilk.ch>

description:
  The ESP32-S31 cache controller fronts the external PSRAM aperture. Its sync
  engine performs address-ranged invalidate, writeback and writeback-invalidate
  operations, which the kernel uses for DMA cache maintenance because the hart
  implements no Zicbom and the SoC exposes no uncached alias of that aperture.

properties:
  compatible:
    const: espressif,esp32s31-cache

  reg:
    maxItems: 1

  cache-line-size:
    const: 64

  cache-level:
    const: 1

required:
  - compatible
  - reg

additionalProperties: false

examples:
  - |
    cache-controller@2c000000 {
        compatible = "espressif,esp32s31-cache";
        reg = <0x2c000000 0x1000>;
        cache-line-size = <64>;
        cache-level = <1>;
    };
```

## linux/Documentation/devicetree/bindings/clock/esp,esp32s31-clkrst.yaml
```yaml
# SPDX-License-Identifier: (GPL-2.0-only OR BSD-2-Clause)
%YAML 1.2
---
$id: http://devicetree.org/schemas/clock/esp,esp32s31-clkrst.yaml#
$schema: http://devicetree.org/meta-schemas/core.yaml#

title: Espressif ESP32-S31 clock and reset controllers

maintainers:
  - Marco Mueller <hello@annoyedmilk.ch>

description: |
  Three blocks have clocks and resets for the operating system:

  - LP_AONCLKRST makes the MPLL. The firmware sets it for the PSRAM, so the
    operating system only reads its rate.
  - HP_SYS_CLKRST makes the CPU, SYS and APB clocks, which the firmware
    sets, and has the clocks and the reset of each peripheral, for example
    I2C.
  - CNNT_SYS makes the EMAC TX clock, has the EMAC and SD host resets, and
    has the EMAC interface registers, which the EMAC gets as a syscon.

  The clock and reset numbers are in dt-bindings/clock/esp32s31-clk.h.

properties:
  compatible:
    enum:
      - esp,esp32s31-lp-clkrst
      - esp,esp32s31-hp-clkrst
      - esp,esp32s31-cnnt-sys

  reg:
    maxItems: 1

  clocks:
    minItems: 1
    maxItems: 3

  clock-names:
    minItems: 1
    maxItems: 3

  "#clock-cells":
    const: 1

  "#reset-cells":
    const: 1

required:
  - compatible
  - reg
  - clocks
  - clock-names
  - "#clock-cells"

allOf:
  - if:
      properties:
        compatible:
          const: esp,esp32s31-lp-clkrst
    then:
      properties:
        clocks:
          items:
            - description: 40 MHz crystal
        clock-names:
          items:
            - const: xtal
        "#reset-cells": false
  - if:
      properties:
        compatible:
          const: esp,esp32s31-hp-clkrst
    then:
      properties:
        clocks:
          items:
            - description: 40 MHz crystal
            - description: CPLL, 320 MHz
            - description: MPLL, the source of the SD host clock
        clock-names:
          items:
            - const: xtal
            - const: cpll
            - const: mpll
      required:
        - "#reset-cells"
  - if:
      properties:
        compatible:
          const: esp,esp32s31-cnnt-sys
    then:
      properties:
        clocks:
          items:
            - description: MPLL
            - description: CPLL, 320 MHz
        clock-names:
          items:
            - const: mpll
            - const: cpll
      required:
        - "#reset-cells"

additionalProperties: false

examples:
  - |
    #include <dt-bindings/clock/esp32s31-clk.h>

    lp_clkrst: clock-controller@20701000 {
        compatible = "esp,esp32s31-lp-clkrst";
        reg = <0x20701000 0x1000>;
        clocks = <&xtal>;
        clock-names = "xtal";
        #clock-cells = <1>;
    };

    clock-controller@20359000 {
        compatible = "esp,esp32s31-cnnt-sys";
        reg = <0x20359000 0x1000>;
        clocks = <&lp_clkrst ESP32S31_LP_CLK_MPLL>, <&cpll>;
        clock-names = "mpll", "cpll";
        #clock-cells = <1>;
        #reset-cells = <1>;
    };
```
