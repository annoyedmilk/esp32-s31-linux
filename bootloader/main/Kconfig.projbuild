## bootloader/main/Kconfig.projbuild
```kconfig
menu "ESP32-S31 Linux loader"

config S31_LINUX_DISPLAY
    bool "Start the 800x480 RGB panel of the ESP32-S31-Korvo-1"
    default n
    help
        The loader starts the panel and keeps its frame buffer at
        0x50F40000 for Linux.  sdkconfig.defaults.korvo1 sets it.

config S31_LINUX_BOARD_ESP_MOSAICO
    bool "ESP-Mosaico CoreBoard V1.2 (QSPI LCD, CST9220 touch)"
    default n
    depends on !S31_LINUX_DISPLAY
    help
        Build the ESP-Mosaico board code of the loader.  Linux owns the
        board peripherals.  sdkconfig.defaults.esp-mosaico sets it.

endmenu
```

## linux/Documentation/devicetree/bindings/display/chipone,co5300.yaml
```yaml
# SPDX-License-Identifier: (GPL-2.0-only OR BSD-2-Clause)
%YAML 1.2
---
$id: http://devicetree.org/schemas/display/chipone,co5300.yaml#
$schema: http://devicetree.org/meta-schemas/core.yaml#

title: Chipone CO5300 QSPI AMOLED panel

maintainers:
  - Espressif Linux Port Maintainers <linux-riscv@espressif.com>

description: |
  Local binding for the CO5300 framebuffer console. Command headers and
  command parameters use one SPI lane. Pixel data uses four lanes.
  Panel geometry and vendor initialization must match the actual module.

allOf:
  - $ref: /schemas/spi/spi-peripheral-props.yaml#

properties:
  compatible:
    const: chipone,co5300

  reg:
    maxItems: 1

  spi-max-frequency:
    maximum: 80000000

  spi-tx-bus-width:
    const: 4

  reset-gpios:
    maxItems: 1

  chipone,width:
    $ref: /schemas/types.yaml#/definitions/uint32
    description: Visible width in pixels.
    minimum: 1
    maximum: 512
    default: 466

  chipone,height:
    $ref: /schemas/types.yaml#/definitions/uint32
    description: Visible height in pixels.
    minimum: 1
    maximum: 512
    default: 466

  chipone,x-offset:
    $ref: /schemas/types.yaml#/definitions/uint32
    description: First visible column in controller RAM.
    maximum: 65534
    default: 6

  chipone,y-offset:
    $ref: /schemas/types.yaml#/definitions/uint32
    description: First visible row in controller RAM.
    maximum: 65534
    default: 0

  chipone,init-sequence:
    $ref: /schemas/types.yaml#/definitions/uint8-array
    minItems: 4
    maxItems: 4096
    description: |
      Optional supplier initialization replacing the reference sequence.
      Each record contains command, payload length, delay in milliseconds
      as two bytes (MSB first), and payload. The driver validates record
      boundaries. MADCTL 0 and COLMOD 0x55 precede this sequence, and
      Display On (0x29) follows it. Include Sleep Out and its delay.
      Geometry plus offsets must fit in 16-bit column/row addresses.

required:
  - compatible
  - reg
  - spi-max-frequency
  - spi-tx-bus-width
  - reset-gpios

unevaluatedProperties: false
...
```
